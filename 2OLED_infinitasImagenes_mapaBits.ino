/*-----------------------------------------------------------------------------------
  Programa en ARDUINO IDE con C++, simple para Mostrar una secuencia de Imagenes
  en tu RP2040 zero de Aliexpress en 2 pantallas.

  Segurate de tener Istalado los repocitorios:

  https://github.com/adafruit/Adafruit-GFX-Library

  https://github.com/adafruit/Adafruit_SSD1306


                              IMPORTANTE

  Abre la Libreria Adafruit_SSD1306 en C++ y editala con un Editor C++:

  C:\Users\TuNombreDeUsuario\Documents\Arduino\libraries\Adafruit_SSD1306
  Abre el Documento Adafruit_SSD1306.cpp

  Busca la linea:
  41|
  42| #include <pgmspace.h>
  43|

  Y "comentala"; Debería de quedar así:

  41|
  42| //#include <pgmspace.h>
  43|

  Si no haces esto no funcionará y te mostrará esa misma librería como "error".

                    *AQUÍ TERMINA LO IMPORTANTE*


  Este programa utiliza los "PIN" "Predeterminados" proporcionados por Arduino IDE.
            
                              -----____-----
                            5V|   |    |   |0
                           GND|    ----    |1
                           3V3|            |2
                            29|            |3       Wire0
                  Wire1:    28|            |4 <---- GP4  SDA
            SCL   GP27----> 27|            |5 <---- GP5  SCL
            SDA   GP26----> 26|            |6
                            15|            |7
                            14|            |8
                              --------------
                               13 12 11 10 9
                        RP2040 zero 2MB (Aliexpress)


    Este programa es para una pantalla 128x64 pixeles Blanca.

           OLED0 PRIMARIA              OLED1 Secundaria
               3V3                          3V3
           GND /5V GP4 GP5              GND /5V  GP  GP
            |   |   |   |                |   |   27  26
            |   |   |   |                |   |   |   |
            |   |   |   |                |   |   |   |
            V   V   V   V                V   V   V   V
           GND VCC SCL SDA              GND VCC SCL SDA
          -----------------             ----------------
          |*   . . . .    *|           |*   . . . .    *|
          |   ----------   |           |   ----------   |
          |  |          |  |           |  |          |  |
          |  |          |  |           |  |          |  |
          |   ----------   |           |   ----------   |
          -*--------------*-           -*--------------*-
         display0 128x64 3,3 V-5V     display1 128x64 3,3 V-5V
           MonoCromatica, Blanco       MonoCromatica, Blanco


Espero que más gente pueda Aprender con el RP2040 y C++,
hice esto porque no encontré ningun tutorial al respecto.

                    *Gracias por Leer*

     Porque Jehová(Yahweh) da la sabiduría, Y de su boca
   viene el conocimiento y la inteligencia. —Proverbios 2:6.
-----------------------------------------------------------------------------------*/

#include <Wire.h>
#include <Adafruit_GFX.h>
#include <Adafruit_SSD1306.h>


#define SCREEN_WIDTH 128      //Define el tamaño X de la pantalla.
#define SCREEN_HEIGHT 64      //Define el tamaño Y de la pantalla.

Adafruit_SSD1306 display0(SCREEN_WIDTH, SCREEN_HEIGHT, &Wire, -1);  //OLED0
Adafruit_SSD1306 display1(SCREEN_WIDTH, SCREEN_HEIGHT, &Wire1, -1); //OLED1

// 'ROKUROSIX', 128x64px
const unsigned char ROKUROSIX [] PROGMEM = {
	0x00, 0x00, 0x00, 0x00, 0x00, 0x00, 0x00, 0x00, 0x00, 0x00, 0x00, 0x00, 0x00, 0x00, 0x00, 0x00, 
	0x00, 0x00, 0x00, 0x00, 0x00, 0x00, 0x00, 0x00, 0x00, 0x00, 0x00, 0x00, 0x00, 0x00, 0x00, 0x00, 
	0x3f, 0xff, 0xff, 0xfc, 0x03, 0x00, 0x01, 0x00, 0x40, 0x10, 0x08, 0x00, 0x00, 0x42, 0xd2, 0xc0, 
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	0x03, 0xf0, 0x00, 0x00, 0x00, 0x00, 0x00, 0x00, 0x00, 0x00, 0x00, 0x00, 0x00, 0x00, 0x00, 0x00
};

// 'LogoROKUROSIX', 128x64px
const unsigned char LogoROKUROSIX [] PROGMEM = {
	0x00, 0x00, 0x00, 0x00, 0x00, 0x7f, 0xfc, 0x00, 0x00, 0x07, 0xff, 0xf0, 0x00, 0x00, 0x00, 0x00, 
	0x00, 0x00, 0x00, 0x00, 0x00, 0x7f, 0xfe, 0x00, 0x00, 0x0f, 0xff, 0xf0, 0x00, 0x00, 0x00, 0x00, 
	0x00, 0x00, 0x00, 0x00, 0x00, 0x7f, 0xfe, 0x00, 0x00, 0x0f, 0xff, 0xf8, 0x00, 0x00, 0x00, 0x00, 
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	0x00, 0x00, 0x00, 0x00, 0x00, 0x00, 0x07, 0xff, 0xff, 0xfc, 0x00, 0x00, 0x00, 0x00, 0x00, 0x00
};

//Aquí puedes poner tu mapa de Bits 128x64; Recuerda Nombrarlo como en la lista "imagenUno".
const unsigned char imagenUno [] PROGMEM = {
	0xff, 0xff, 0xff, 0xff, 0xff, 0xff, 0xff, 0xff, 0xff, 0xff, 0xff, 0xff, 0xff, 0xff, 0xff, 0xff, 
	0xff, 0xff, 0xff, 0xff, 0xff, 0xff, 0xff, 0xff, 0xff, 0xff, 0xff, 0xff, 0xff, 0xff, 0xff, 0xff, 
	0xff, 0xff, 0xff, 0xff, 0xff, 0xff, 0xff, 0xff, 0xff, 0xff, 0xff, 0xff, 0xff, 0xff, 0xff, 0xff, 
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	0xff, 0xff, 0xff, 0xff, 0xff, 0xff, 0xff, 0xff, 0xff, 0xff, 0xff, 0xff, 0xff, 0xff, 0xff, 0xff
};

//Aquí puedes poner tu mapa de Bits 128x64; Recuerda Nombrarlo como en la lista "imagenDos".
const unsigned char imagenDos [] PROGMEM = {
	0xff, 0xff, 0xff, 0xff, 0xff, 0xff, 0xff, 0xff, 0xff, 0xff, 0xff, 0xff, 0xff, 0xff, 0xff, 0xff, 
	0xff, 0xff, 0xff, 0xff, 0xff, 0xff, 0xff, 0xff, 0xff, 0xff, 0xff, 0xff, 0xff, 0xff, 0xff, 0xff, 
	0xff, 0xff, 0xff, 0xff, 0xff, 0xff, 0xff, 0xff, 0xff, 0xff, 0xff, 0xff, 0xff, 0xff, 0xff, 0xff, 
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	0xff, 0xff, 0xff, 0xff, 0xff, 0xff, 0xff, 0xff, 0xff, 0xff, 0xff, 0xff, 0xff, 0xff, 0xff, 0xff
};

//Aquí puedes poner tu mapa de Bits 128x64; Recuerda Nombrarlo como en la lista "imagenTres".
const unsigned char imagenTres [] PROGMEM = {
	0xff, 0xff, 0xff, 0xff, 0xff, 0xff, 0xff, 0xff, 0xff, 0xff, 0xff, 0xff, 0xff, 0xff, 0xff, 0xff, 
	0xff, 0xff, 0xff, 0xff, 0xff, 0xff, 0xff, 0xff, 0xff, 0xff, 0xff, 0xff, 0xff, 0xff, 0xff, 0xff, 
	0xff, 0xff, 0xff, 0xff, 0xff, 0xff, 0xff, 0xff, 0xff, 0xff, 0xff, 0xff, 0xff, 0xff, 0xff, 0xff, 
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	0xff, 0xff, 0xff, 0xff, 0xff, 0xff, 0xff, 0xff, 0xff, 0xff, 0xff, 0xff, 0xff, 0xff, 0xff, 0xff
};

//Aquí puedes poner tu mapa de Bits 128x64; Recuerda Nombrarlo como en la lista "imagenCuatro".
const unsigned char imagenCuatro [] PROGMEM = {
	0xff, 0xff, 0xff, 0xff, 0xff, 0xff, 0xff, 0xff, 0xff, 0xff, 0xff, 0xff, 0xff, 0xff, 0xff, 0xff, 
	0xff, 0xff, 0xff, 0xff, 0xff, 0xff, 0xff, 0xff, 0xff, 0xff, 0xff, 0xff, 0xff, 0xff, 0xff, 0xff, 
	0xff, 0xff, 0xff, 0xff, 0xff, 0xff, 0xff, 0xff, 0xff, 0xff, 0xff, 0xff, 0xff, 0xff, 0xff, 0xff, 
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	0xff, 0xff, 0xff, 0xff, 0xff, 0xff, 0xff, 0xff, 0xff, 0xff, 0xff, 0xff, 0xff, 0xff, 0xff, 0xff
};

//Aquí puedes poner tu mapa de Bits 128x64; Recuerda Nombrarlo como en la lista "imagenCinco".
const unsigned char imagenCinco [] PROGMEM = {
	0xff, 0xff, 0xff, 0xff, 0xff, 0xff, 0xff, 0xff, 0xff, 0xff, 0xff, 0xff, 0xff, 0xff, 0xff, 0xff, 
	0xff, 0xff, 0xff, 0xff, 0xff, 0xff, 0xff, 0xff, 0xff, 0xff, 0xff, 0xff, 0xff, 0xff, 0xff, 0xff, 
	0xff, 0xff, 0xff, 0xff, 0xff, 0xff, 0xff, 0xff, 0xff, 0xff, 0xff, 0xff, 0xff, 0xff, 0xff, 0xff, 
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	0xff, 0xff, 0xff, 0xff, 0xff, 0xff, 0xff, 0xff, 0xff, 0xff, 0xff, 0xff, 0xff, 0xff, 0xff, 0xff
};

/*Puedes agregar más imágenes, solo repite lo que hiciste y sigue agregando (imagenSeis,
imagenSiete, imagenOcho) Solo recuerda nombrarlas en la lista "char" para llamarlas en la pantalla.
Y modifica la función "int totalImages" de a cuerdo al número total de Imágenes que pusiste.*/

void setup() {
  if (!display0.begin(SSD1306_SWITCHCAPVCC, 0x3C)) {
    Serial.println(F("OLED 0 fallo!"));
    for (;;);
  }
  display0.clearDisplay();        //Esto limpia la pantalla.

  if (!display1.begin(SSD1306_SWITCHCAPVCC, 0x3C)) {
    Serial.println(F("OLED 1 fallo!"));
    for (;;);
  }
  display1.clearDisplay();        //Esto limpia la pantalla.
}

void loop() {
  static int imagenIndex = 0;    //Este es el numero de la imagen que pondrá cuando se complete el "loop".


                                 //Aquí tendrás que agregar cada una de las imagenes extra que agregaste:
  const unsigned char* imagenes0[] = {LogoROKUROSIX, imagenUno, imagenDos, imagenTres, imagenCuatro, imagenCinco};
  const unsigned char* imagenes1[] = {ROKUROSIX, imagenCinco, imagenCuatro, imagenTres, imagenDos, imagenUno};
                                 //Si no agregas el Nombre de las imagenes No aparecerán.

  const int totalDeImagenes = 6; //Este es el número total de imágenes que tengas.

  display0.clearDisplay();
  display1.clearDisplay();

  display0.drawBitmap(0, 0, imagenes0[imagenIndex], SCREEN_WIDTH, SCREEN_HEIGHT, SSD1306_WHITE);
  display1.drawBitmap(0, 0, imagenes1[imagenIndex], SCREEN_WIDTH, SCREEN_HEIGHT, SSD1306_WHITE);

  display0.display();
  display1.display();

  imagenIndex++;                 //Aumenta +1 cada vez que se completa el ciclo
  if (imagenIndex >= totalDeImagenes) 
  {
    imagenIndex = 0;             //Hace Volver al inicio cuando llegue al final de la lista, lo escrito en: (totalDeImegenes).
  }

  delay(3000);                   //Tiempo de espera; Cada 1000 ciclos es aprox: 1 segundo mostrando la Imagen.
}
